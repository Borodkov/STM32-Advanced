/**
  ******************************************************************************
    File Name          : CLIconsole_USB.c
    Description        : Code for serial driver for CLI UART application
  ******************************************************************************
*/

/* Standard includes. */
#include <string.h>
#include <stdint.h>

/* OS includes. */
#include "cmsis_os.h"

/* Command Line Inbterprete includes. */
#include "FreeRTOS_CLI.h"

/* STM32 includes. */
#include "usbd_cdc_if.h"
#include "BSP_IZUMRUD.h"

/*----------------------------------------------------------------------------*/
#define cmdQUEUE_LENGTH 25
#define cmdMAX_MUTEX_WAIT (((TickType_t)300) / (portTICK_PERIOD_MS))

/*----------------------------------------------------------------------------*/
osMutexId xUSBTxMutex = NULL;
osMessageQId xRxedChars = NULL; /* The queue used to hold received characters. */

/*----------------------------------------------------------------------------*/
void prvUSBCommandInterpreterTask(void const *pvParameters) {
    char cRxedChar;
    uint8_t ucInputIndex = 0;
    char *pcOutputString;
    char cInputString[cmdMAX_INPUT_SIZE], cLastInputString[cmdMAX_INPUT_SIZE];
    BaseType_t xReturned;
    (void)pvParameters;
    /*  Obtain the address of the output buffer.
        Note there is no mutual exclusion on this buffer as it is assumed only one
        command console interface will be used at any one time. */
    pcOutputString = FreeRTOS_CLIGetOutputBuffer();
    /* Clear strings. */
    memset(cInputString,     0x00, cmdMAX_INPUT_SIZE);
    memset(cLastInputString, 0x00, cmdMAX_INPUT_SIZE);
    /* Create the queues used to hold Rx/Tx characters. */
    xRxedChars = xQueueCreate(cmdQUEUE_LENGTH, sizeof(char));

    /* Send the welcome message. */
    while (USBD_OK != CDC_Transmit_FS((uint8_t *)pcNewLine, strlen(pcNewLine))) {
        osDelay(1);
    }

    while (USBD_OK != CDC_Transmit_FS((uint8_t *)pcWelcomeMessage, strlen(pcWelcomeMessage))) {
        osDelay(1);
    }

    for (;;) {
        /*  Wait for the next character.  The while loop is used in case
            INCLUDE_vTaskSuspend is not set to 1 - in which case portMAX_DELAY will
            be a genuine block time rather than an infinite block time. */
        xQueueReceive(xRxedChars, (char *)&cRxedChar, portMAX_DELAY);

        /* Ensure exclusive access to the USBFS Tx. */
        if (osOK == osMutexWait(xUSBTxMutex, 5)) {
            /* Echo the character back. */
            while (USBD_OK != CDC_Transmit_FS((uint8_t *)&cRxedChar, 1)) {
                osDelay(1);
            }

            /* Was it the end of the line? */
            if ((cRxedChar == '\n') || (cRxedChar == '\r')) {
                BSP_AUDIO_Play(SND_GET_CMD);

                /* Just to space the output from the input. */
                while (USBD_OK != CDC_Transmit_FS((uint8_t *)pcNewLine, strlen(pcNewLine))) {
                    osDelay(1);
                }

                /* See if the command is empty, indicating that the last command is to be executed again. */
                if (ucInputIndex == 0) {
                    /* Copy the last command back into the input string. */
                    strcpy(cInputString, cLastInputString);
                }

                /*  Pass the received command to the command interpreter.
                    The command interpreter is called repeatedly until it returns pdFALSE
                    (indicating there is no more output) as it might generate more than one string. */
                do {
                    /* Get the next output string from the command interpreter. */
                    xReturned = FreeRTOS_CLIProcessCommand(cInputString,
                                                           pcOutputString,
                                                           configCOMMAND_INT_MAX_OUTPUT_SIZE);

                    /* Write the generated string to the USBFS. */
                    while (USBD_OK != CDC_Transmit_FS((uint8_t *)pcOutputString, strlen(pcOutputString))) {
                        osDelay(1);
                    }
                } while (xReturned != pdFALSE);

                /*  All the strings generated by the input command have been sent.
                    Clear the input string ready to receive the next command.
                    Remember the command that was just processed first
                    in case it is to be processed again. */
                strcpy(cLastInputString, cInputString);
                ucInputIndex = 0;
                memset(cInputString, 0x00, cmdMAX_INPUT_SIZE);

                while (USBD_OK != CDC_Transmit_FS((uint8_t *)pcEndOfOutputMessage, strlen(pcEndOfOutputMessage))) {
                    osDelay(1);
                }
            } else {
                if ((cRxedChar == '\b') || (cRxedChar == cmdASCII_DEL)) {
                    /*  Backspace was pressed.  Erase the last character in the
                        string - if any. */
                    if (ucInputIndex > 0) {
                        cInputString[--ucInputIndex] = '\0';
                    }
                } else {
                    /*  A character was entered.  Add it to the string entered so far.
                        When a \n is entered the complete string will be passed to the command interpreter. */
                    if ((cRxedChar >= ' ') && (cRxedChar <= '~')) {
                        if (ucInputIndex < cmdMAX_INPUT_SIZE) {
                            cInputString[ucInputIndex++] = cRxedChar;
                        }
                    }
                }
            }

            osMutexRelease(xUSBTxMutex);
        }
    }
}

/*----------------------------------------------------------------------------*/
void vStartUSBFSCommandInterpreterTask() {
    /* Create the mutex used to access the USBFS Tx. */
    osMutexDef(xUSBTxMutex);
    xUSBTxMutex = osMutexCreate(osMutex(xUSBTxMutex));
    osMutexRelease(xUSBTxMutex);
    /*  Create that task that handles the console itself.
        cli_thread     - The task that implements the command console.
        "CLI"          - Text name assigned to the task.  This is just to assist debugging. The kernel does not use this name itself.
        usStackSize    - The size of the stack allocated to the task.
        NULL           - The parameter is not used, so NULL is passed.
        uxPriority     - The priority allocated to the task.
        xCLITaskHandle - Serial drivers that use task notifications may need the CLI task's handle. */
    osThreadDef(CLI_USB,
                prvUSBCommandInterpreterTask,
                osPriorityLow,
                0,
                2 * configMINIMAL_STACK_SIZE);
    osThreadCreate(osThread(CLI_USB), NULL);
}
